## boards/u-blox/ubx_evkninab5/Kconfig.ubx_evkninab5
```kconfig
# Copyright 2024 NXP
# Copyright 2025 u-blox
# SPDX-License-Identifier: Apache-2.0

config BOARD_UBX_EVKNINAB5
	select SOC_MCXW716C
	select SOC_PART_NUMBER_MCXW716CMFTA
```

## boards/u-blox/ubx_evkninab5/board.yml
```yaml
board:
  name: ubx_evkninab5 
  full_name: EVK-NINA-B5
  vendor: nxp
  socs:
    - name: mcxw716c
```
